## firmware/idf/lamp_voice/main/Kconfig.projbuild
```kconfig
menu "LAMP voice link"

    config LAMP_WIFI_SSID
        string "WiFi SSID (leave empty to scan and list networks)"
        default ""

    config LAMP_WIFI_PASS
        string "WiFi password"
        default ""

    config LAMP_SERVER_HOST
        string "PC server IPv4"
        default "10.1.41.14"

    config LAMP_SERVER_PORT
        int "PC server TCP port"
        default 8766

endmenu
```

## firmware/idf/lamp_voice/sdkconfig.defaults
```kconfig
# 控制台走板载 USB-Serial-JTAG（和设备管理器里的 COM 口是同一个）
CONFIG_ESP_CONSOLE_USB_SERIAL_JTAG=y
CONFIG_ESP_CONSOLE_SECONDARY_NONE=y

# YD-ESP32-S3-N16R8：16 MB flash
CONFIG_ESPTOOLPY_FLASHSIZE_16MB=y
CONFIG_PARTITION_TABLE_SINGLE_APP=y

CONFIG_FREERTOS_HZ=1000

# ---- LAMP voice link ----
# SSID 留空时固件会扫描并打印附近 AP，方便先看清环境再填
CONFIG_LAMP_WIFI_SSID=""
CONFIG_LAMP_WIFI_PASS=""
CONFIG_LAMP_SERVER_HOST="10.1.41.14"
CONFIG_LAMP_SERVER_PORT=8766
```

## firmware/idf/pdm_probe/sdkconfig.defaults
```kconfig
# PDM RX：USB-Serial-JTAG 做控制台（板子自带的那个 USB 口）
CONFIG_ESP_CONSOLE_USB_SERIAL_JTAG=y
CONFIG_ESP_CONSOLE_SECONDARY_NONE=y

# 板子是 YD-ESP32-S3-N16R8：16 MB flash
CONFIG_ESPTOOLPY_FLASHSIZE_16MB=y

# 单 app 分区就够了，这个固件只有几百 KB
CONFIG_PARTITION_TABLE_SINGLE_APP=y

CONFIG_FREERTOS_HZ=1000
CONFIG_LOG_DEFAULT_LEVEL_INFO=y
```
